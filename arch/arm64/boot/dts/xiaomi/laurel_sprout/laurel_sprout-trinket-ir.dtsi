&qupv3_se0_spi {
	qcom,infinite-mode = <0>;
	qcom,usb-bam;
	qcom,rt-priority;
	qcom,use-pinctrl;
	qcom,ver-reg-exists;
	qcom,bam-consumer-pipe-index = <6>;
	qcom,bam-producer-pipe-index = <7>;
	qcom,master-id = <84>;
	status = "ok";
	spi_ir@1 {
		compatible = "ir-spi-led";
		reg = <1>;

		duty-cycle = <30>;
		spi-max-frequency = <50000000>;
	};
};
