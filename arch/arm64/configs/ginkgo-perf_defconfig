## drivers/input/touchscreen/focaltech_touch/Kconfig
```kconfig
#
# Focaltech Touchscreen driver configuration
#

config TOUCHSCREEN_FTS_F9S
    bool "Focaltech Touchscreen"
    depends on I2C
    default n
    help
      Say Y here if you have Focaltech touch panel.
      If unsure, say N.

config TOUCHSCREEN_FTS_F9S_DIRECTORY
    string "Focaltech ts directory name"
    default "focaltech_touch"
    depends on TOUCHSCREEN_FTS_F9S
```

## drivers/input/touchscreen/goodix_gtx8/Kconfig
```kconfig
#
# Goodix touchscreen driver configuration
#
menuconfig TOUCHSCREEN_GOODIX_F9S
	bool "Goodix GTx8 touchscreen"
	depends on ( SPI || TOUCHSCREEN_XIAOMI_F9S )
	depends on I2C
	default n
	help
	  Say Y here if you have a Goodix GTx5xx touchscreen connected
	  to your system.
```
